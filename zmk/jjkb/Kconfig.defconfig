## zmk/jjkb/Kconfig.defconfig
```kconfig
# Copyright (c) 2023 The ZMK Contributors
# SPDX-License-Identifier: MIT

if SHIELD_JJKB

# Max 16 characters in keyboard name
config ZMK_KEYBOARD_NAME
    default "JJKB-S"

endif
```
