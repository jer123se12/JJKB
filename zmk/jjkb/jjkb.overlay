#include <dt-bindings/zmk/matrix_transform.h>
#include "jjkb.dtsi"
/ {
    chosen {
        zmk,kscan = &kscan0;
    };



    kscan0: kscan_0 {
        compatible = "zmk,kscan-gpio-matrix";
        wakeup-source;

        diode-direction = "col2row";

        col-gpios
            = <&gpio1 1  GPIO_ACTIVE_HIGH>
            , <&gpio1 2  GPIO_ACTIVE_HIGH>
            , <&gpio1 4  GPIO_ACTIVE_HIGH>
            , <&gpio1 6  GPIO_ACTIVE_HIGH>
            , <&gpio0 4  GPIO_ACTIVE_HIGH>
            , <&gpio0 31 GPIO_ACTIVE_HIGH>
            , <&gpio0 30 GPIO_ACTIVE_HIGH>
            , <&gpio0 29 GPIO_ACTIVE_HIGH>
            , <&gpio0 28 GPIO_ACTIVE_HIGH>
            , <&gpio0 2  GPIO_ACTIVE_HIGH>
            ;

        row-gpios
            = <&gpio1 10 (GPIO_ACTIVE_HIGH | GPIO_PULL_DOWN)>
            , <&gpio1 11 (GPIO_ACTIVE_HIGH | GPIO_PULL_DOWN)>
            , <&gpio1 13 (GPIO_ACTIVE_HIGH | GPIO_PULL_DOWN)>
            , <&gpio0 3  (GPIO_ACTIVE_HIGH | GPIO_PULL_DOWN)>
            ;
    };
};
